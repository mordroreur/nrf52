## sample.yaml
```
sample:
  name: Bluetooth Detector
  description: A key finder
tests:
  sample.bluetooth.peripheral_hr:
    harness: bluetooth
    platform_allow: qemu_cortex_m3 qemu_x86
    integration_platforms:
      - qemu_cortex_m3
    tags: bluetooth
  sample.bluetooth.peripheral_hr_rv32m1_vega_ri5cy:
    platform_allow: rv32m1_vega_ri5cy
    tags: bluetooth
    build_only: true
  sample.bluetooth.peripheral_hr.frdm_kw41z_shield:
    harness: bluetooth
    depends_on: arduino_serial
    tags: bluetooth
    extra_args: SHIELD=frdm_kw41z
  sample.basic.button:
    tags: button gpio
    filter: dt_enabled_alias_with_parent_compat("sw0", "gpio-keys")
    depends_on: gpio
    harness: button
  sample.drivers.led.led_pwm:
    filter: dt_compat_enabled("pwm-leds")
    tags: LED
    depends_on: pwm
    platform_exclude: reel_board
    timeout: 20
    harness: console
    harness_config:
      type: multi_line
      ordered: true
      regex:
        - "Testing LED \\d+"
        - "Turned on"
        - "Turned off"
        - "Increasing brightness gradually"
        - "Blinking on: 0.1 sec, off: 0.1 sec"
        - "(Blinking on: 1 sec, off: 1 sec|Cycle period not supported)"
        - "Turned off, loop end"
```

## prj.conf
```kconfig
CONFIG_BT=y
CONFIG_LOG=y
CONFIG_PWM=y
CONFIG_LED=y
CONFIG_LOG_MODE_IMMEDIATE=y
CONFIG_BT_DEBUG_LOG=y
CONFIG_BT_SMP=y
CONFIG_BT_PERIPHERAL=y
CONFIG_BT_DIS=y
CONFIG_BT_DIS_PNP=n
CONFIG_BT_BAS=y
CONFIG_BT_HRS=y
CONFIG_BT_DEVICE_NAME="Math Test"
CONFIG_BT_DEVICE_APPEARANCE=964
```

## nrf52dk_nrf52832.overlay
```dts
// To get started, press Ctrl+Space to bring up the completion menu and view the available nodes.

// You can also use the buttons in the sidebar to perform actions on nodes.
// Actions currently available include:

// * Enabling / disabling the node
// * Adding the bus to a bus
// * Removing the node
// * Connecting ADC channels

// For more help, browse the DeviceTree documentation at https://docs.zephyrproject.org/latest/guides/dts/index.html
// You can also visit the nRF DeviceTree extension documentation at https://nrfconnect.github.io/vscode-nrf-connect/devicetree/nrfdevicetree.html

/ {

    pwmleds {
		compatible = "pwm-leds";
		pwm_ledMat: pwm_led_Mat {
			pwms = <&pwm0 24 PWM_MSEC(20) PWM_POLARITY_INVERTED>;
		};
	};

    /* These aliases are provided for compatibility with samples */
	aliases {
		pwm-ledmat = &pwm_ledMat;
	};
};
```

## src/main.c
```c
/* main.c - Application main entry point */

/*
 * Copyright (c) 2015-2016 Intel Corporation
 *
 * SPDX-License-Identifier: Apache-2.0
 */

#include <inttypes.h>
#include <zephyr/types.h>
#include <stddef.h>
#include <string.h>
#include <errno.h>
#include <zephyr/sys/printk.h>
#include <zephyr/sys/byteorder.h>
#include <zephyr/kernel.h>
#include <zephyr/device.h>
#include <zephyr/devicetree.h>
#include <errno.h>
#include <zephyr/drivers/led.h>
#include <zephyr/sys/util.h>
#include <zephyr/kernel.h>

#include <zephyr/logging/log.h>
#include <zephyr/bluetooth/bluetooth.h>
#include <zephyr/bluetooth/hci.h>
#include <zephyr/bluetooth/conn.h>
#include <zephyr/bluetooth/uuid.h>
#include <zephyr/bluetooth/gatt.h>
#include <zephyr/bluetooth/services/bas.h>

#include <zephyr/kernel.h>
#include <zephyr/device.h>
#include <zephyr/drivers/gpio.h>
#include <zephyr/sys/util.h>
#include <zephyr/sys/printk.h>
#include <inttypes.h>

#include "peripherique.h"
LOG_MODULE_REGISTER(main, CONFIG_LOG_DEFAULT_LEVEL);
#define SLEEP_TIME_MS	1

/*
 * Get button configuration from the devicetree sw0 alias. This is mandatory.
 */
#define SW0_NODE	DT_ALIAS(sw0)
#if !DT_NODE_HAS_STATUS(SW0_NODE, okay)
#error "Unsupported board: sw0 devicetree alias is not defined"
#endif
/*
#define MAX_BRIGHTNESS	100

#define FADE_DELAY_MS	10
#define FADE_DELAY	K_MSEC(FADE_DELAY_MS)

#define LED_PWM_NODE_ID	 DT_COMPAT_GET_ANY_STATUS_OKAY(pwm_leds)

const char *led_label[] = {
	DT_FOREACH_CHILD_SEP_VARGS(LED_PWM_NODE_ID, DT_PROP_OR, (,), label, NULL)
};

const int num_leds = ARRAY_SIZE(led_label);
*/

static int pressed;   



static const struct gpio_dt_spec button = GPIO_DT_SPEC_GET_OR(SW0_NODE, gpios, {0});
static struct gpio_callback button_cb_data;

/*
 * The led0 devicetree alias is optional. If present, we'll use it
 * to turn on the LED whenever the button is pressed.
 */
static struct gpio_dt_spec led = GPIO_DT_SPEC_GET_OR(DT_ALIAS(led0), gpios, {0});

static struct gpio_dt_spec buzzer = GPIO_DT_SPEC_GET_OR(DT_ALIAS(pwm_ledmat), gpios, {0});



static const struct bt_data ad[] = {
	BT_DATA_BYTES(BT_DATA_FLAGS, (BT_LE_AD_GENERAL | BT_LE_AD_NO_BREDR)),
	BT_DATA_BYTES(BT_DATA_UUID16_ALL,
		      BT_UUID_16_ENCODE(BT_UUID_HRS_VAL),
		      BT_UUID_16_ENCODE(BT_UUID_BAS_VAL),
		      BT_UUID_16_ENCODE(BT_UUID_DIS_VAL))
};


static void connected(struct bt_conn *conn, uint8_t err)
{
	if (err) {
		printk("Connection failed (err 0x%02x)\n", err);
	} else {
		printk("Connected\n");
	}
}

static void disconnected(struct bt_conn *conn, uint8_t reason)
{
	printk("Disconnected (reason 0x%02x)\n", reason);
}

BT_CONN_CB_DEFINE(conn_callbacks) = {
	.connected = connected,
	.disconnected = disconnected,
};

static void bt_ready(void)
{
	int err;

	printk("Bluetooth initialized\n");

	err = bt_le_adv_start(BT_LE_ADV_CONN_NAME, ad, ARRAY_SIZE(ad), NULL, 0);
	if (err) {
		printk("Advertising failed to start (err %d)\n", err);
		return;
	}

	printk("Advertising successfully started\n");
}

static void auth_cancel(struct bt_conn *conn)
{
	char addr[BT_ADDR_LE_STR_LEN];

	bt_addr_le_to_str(bt_conn_get_dst(conn), addr, sizeof(addr));

	printk("Pairing cancelled: %s\n", addr);
}

static struct bt_conn_auth_cb auth_cb_display = {
	.cancel = auth_cancel,
};

static void bas_notify(void)
{
	uint8_t battery_level = bt_bas_get_battery_level();

	battery_level--;

	if (!battery_level) {
		battery_level = 100U;
	}

	bt_bas_set_battery_level(battery_level);
}

static void but_notify(void)
{
	bt_but_set_button_value(0xFF);
	k_sleep(K_SECONDS(0.1));
	bt_but_set_button_value(0x00);
	pressed = 0;
}




void button_pressed(const struct device *dev, struct gpio_callback *cb,
		    uint32_t pins)
{
	printk("Button pressed at %" PRIu32 "\n", k_cycle_get_32());
	/* Send buton information level simulation */
	pressed = 1;
}


/**
 * @brief Run tests on a single LED using the LED API syscalls.
 *
 * @param led_pwm LED PWM device.
 * @param led Number of the LED to test.
 *//*
static void run_led_test(const struct device *led_pwm, uint8_t led)
{
	int err;
	uint16_t level;

	LOG_INF("Testing LED %d - %s", led, led_label[led] ? : "no label");

	// Turn LED on. 
	err = led_on(led_pwm, led);
	if (err < 0) {
		LOG_ERR("err=%d", err);
		return;
	}
	LOG_INF("  Turned on");
	k_sleep(K_MSEC(1000));

	// Turn LED off. 
	err = led_off(led_pwm, led);
	if (err < 0) {
		LOG_ERR("err=%d", err);
		return;
	}
	LOG_INF("  Turned off");
	k_sleep(K_MSEC(1000));

	// Increase LED brightness gradually up to the maximum level.
	LOG_INF("  Increasing brightness gradually");
	for (level = 0; level <= MAX_BRIGHTNESS; level++) {
		err = led_set_brightness(led_pwm, led, level);
		if (err < 0) {
			LOG_ERR("err=%d brightness=%d\n", err, level);
			return;
		}
		k_sleep(FADE_DELAY);
	}
	k_sleep(K_MSEC(1000));

	// Set LED blinking (on: 0.1 sec, off: 0.1 sec)
	err = led_blink(led_pwm, led, 100, 100);
	if (err < 0) {
		LOG_ERR("err=%d", err);
		return;
	}
	LOG_INF("  Blinking on: 0.1 sec, off: 0.1 sec");
	k_sleep(K_MSEC(5000));

	//Enable LED blinking (on: 1 sec, off: 1 sec) 
	err = led_blink(led_pwm, led, 1000, 1000);
	if (err < 0) {
		LOG_ERR("err=%d", err);
		LOG_INF("  Cycle period not supported - on: 1 sec, off: 1 sec");
	} else {
		LOG_INF("  Blinking on: 1 sec, off: 1 sec");
	}
	k_sleep(K_MSEC(5000));

	//Turn LED off.
	err = led_off(led_pwm, led);
	if (err < 0) {
		LOG_ERR("err=%d", err);
		return;
	}
	LOG_INF("  Turned off, loop end");
}
*/









int main(void)
{
	int err;
	pressed = 0;

	err = bt_enable(NULL);
	if (err) {
		printk("Bluetooth init failed (err %d)\n", err);
		return 0;
	}

	bt_ready();

	bt_conn_auth_cb_register(&auth_cb_display);


	// Debut initialisation du bouton 1 : 
	if (!device_is_ready(button.port)) {
		printk("Error: button device %s is not ready\n", button.port->name);
		return 1;
	}
	err = gpio_pin_configure_dt(&button, GPIO_INPUT);
	if (err != 0) {
		printk("Error %d: failed to configure %s pin %d\n", err, button.port->name, button.pin);
		return 1;
	}
	err = gpio_pin_interrupt_configure_dt(&button, GPIO_INT_EDGE_TO_ACTIVE);
	if (err != 0) {
		printk("Error %d: failed to configure interrupt on %s pin %d\n",
			err, button.port->name, button.pin);
		return 1;
	}

	gpio_init_callback(&button_cb_data, button_pressed, BIT(button.pin));
	gpio_add_callback(button.port, &button_cb_data);
	printk("Set up button at %s pin %d\n", button.port->name, button.pin);

	// Debut initialisation de la led

	if (led.port && !device_is_ready(led.port)) {
		printk("Error %d: LED device %s cannot be initilized\n", err, led.port->name);
		return 1;
	}

	err = gpio_pin_configure_dt(&led, GPIO_OUTPUT);
	if (err != 0) {
		printk("Error %d: failed to configure LED device %s pin %d\n", err, led.port->name, led.pin);
		return 1;
	} else {
		printk("Set up LED at %s pin %d\n", led.port->name, led.pin);
	}
	

	// Debut initialisation du buzzer

	if (buzzer.port && !device_is_ready(buzzer.port)) {
		printk("Error %d: Buzzer device %s cannot be initilized\n", err, buzzer.port->name);
		return 1;
	}

	err = gpio_pin_configure_dt(&buzzer, GPIO_OUTPUT);
	if (err != 0) {
		printk("Error %d: failed to configure buzzer device %s pin %d\n", err, buzzer.port->name, buzzer.pin);
		return 1;
	} else {
		printk("Set up buzzer at %s pin %d\n", buzzer.port->name, buzzer.pin);
	}

	gpio_pin_set_dt(&buzzer, 1);

	//gpio_pin_set_dt(&buzzer, 1);
/*
	const struct device *led_pwm;
	uint8_t led;

	led_pwm = DEVICE_DT_GET(LED_PWM_NODE_ID);
	if (!device_is_ready(led_pwm)) {
		LOG_ERR("Device %s is not ready", led_pwm->name);
		return 0;
	}

	if (!num_leds) {
		LOG_ERR("No LEDs found for %s", led_pwm->name);
		return 0;
	}

	do {
		for (led = 0; led < num_leds; led++) {
			run_led_test(led_pwm, led);
		}
	} while (true);
*/



	/* Implement notification. At the moment there is no suitable way
	 * of starting delayed work so we do it here
	 */
	while (1) {
		k_sleep(K_SECONDS(1));

		/* Battery level simulation */
		bas_notify();

		if(pressed){
			but_notify();
		}

		int val = (bt_buz_get_sound_value() > 128)? 1 : 0;//gpio_pin_get_dt(&button);



		gpio_pin_set_dt(&led, val);

	}
	return 0;
}
```

## src/boutton.c
```c
/** @file boutton.c
 *  @brief Button service
 */



#include <errno.h>
#include <zephyr/init.h>
#include <zephyr/sys/__assert.h>
#include <stdbool.h>
#include <zephyr/types.h>

#include <zephyr/bluetooth/bluetooth.h>
#include <zephyr/bluetooth/conn.h>
#include <zephyr/bluetooth/gatt.h>
#include <zephyr/bluetooth/uuid.h>
#include <zephyr/bluetooth/services/bas.h>
#define LOG_LEVEL CONFIG_BT_BAS_LOG_LEVEL
#include <zephyr/logging/log.h>

LOG_MODULE_REGISTER(Button);

static uint8_t buttonValue = 0;

static void blvl_ccc_cfg_changed(const struct bt_gatt_attr *attr,
				       uint16_t value)
{
	ARG_UNUSED(attr);

	bool notif_enabled = (value == BT_GATT_CCC_NOTIFY);

	LOG_INF("BAS Notifications %s", notif_enabled ? "enabled" : "disabled");
}


static ssize_t read_blvl(struct bt_conn *conn,
			       const struct bt_gatt_attr *attr, void *buf,
			       uint16_t len, uint16_t offset)
{
	uint8_t lvl8 = buttonValue;

	return bt_gatt_attr_read(conn, attr, buf, len, offset, &lvl8,
				 sizeof(lvl8));
}

BT_GATT_SERVICE_DEFINE(Button,
	BT_GATT_PRIMARY_SERVICE(BT_UUID_DECLARE_16(0x1401)),
	BT_GATT_CHARACTERISTIC(BT_UUID_DECLARE_16(0x1404),
			       BT_GATT_CHRC_NOTIFY,
			       BT_GATT_PERM_READ, read_blvl, NULL,
			       &buttonValue),
	BT_GATT_CCC(blvl_ccc_cfg_changed,
		    BT_GATT_PERM_READ | BT_GATT_PERM_WRITE),
);

static int but_init(void)
{

	return 0;
}

char bt_but_get_button_value(void)
{
	return buttonValue;
}

int bt_but_set_button_value(uint8_t level)
{
	int rc;

	printk("%d\n", level);
	buttonValue = level;

	rc = bt_gatt_notify(NULL, &Button.attrs[1], &level, sizeof(level));

	return rc == -ENOTCONN ? 0 : rc;
}


SYS_INIT(but_init, APPLICATION, CONFIG_APPLICATION_INIT_PRIORITY);
```

## src/boutton.h
```c
/*
 * Copyright (c) 2018 Nordic Semiconductor ASA
 * Copyright (c) 2016 Intel Corporation
 *
 * SPDX-License-Identifier: Apache-2.0
 */

#ifndef MATH_INCLUDE_BLUETOOTH_SERVICES_BUT_H_
#define MATH_INCLUDE_BLUETOOTH_SERVICES_BUT_H_

/**
 * @brief Button Service 
 * @defgroup bt 
 * @ingroup bluetooth
 * @{
 *
 * [Experimental] Users should note that the APIs can change
 * as a part of ongoing development.
 */

#include <stdint.h>

#ifdef __cplusplus
extern "C" {
#endif

/** @brief Read the button value.
 *
 * Read the characteristic value of the button
 *
 *  @return The button is a boolean.
 */
char bt_but_get_button_value(void);


/** @brief Update button value.
 *
 * Update the characteristic value of the button
 * This will send a GATT notification to all current subscribers.
 *
 *  @param value The button value.
 *
 *  @return Zero in case of success and error code in case of error.
 */
int bt_but_set_button_value(uint8_t level);

#ifdef __cplusplus
}
#endif

/**
 * @}
 */

#endif /* MATH_INCLUDE_BLUETOOTH_SERVICES_BUT_H_ */
```

## src/buzzer.c
```c
/** @file buzzer.c
 *  @brief Buzzer service
 */



#include <errno.h>
#include <zephyr/init.h>
#include <zephyr/sys/__assert.h>
#include <stdbool.h>
#include <zephyr/types.h>

#include <zephyr/bluetooth/bluetooth.h>
#include <zephyr/bluetooth/conn.h>
#include <zephyr/bluetooth/gatt.h>
#include <zephyr/bluetooth/uuid.h>
#include <zephyr/bluetooth/services/bas.h>
#define LOG_LEVEL CONFIG_BT_BAS_LOG_LEVEL
#include <zephyr/logging/log.h>

LOG_MODULE_REGISTER(Buzzer);

static uint8_t SoundValue = 0;

static void blvl_ccc_cfg_changed(const struct bt_gatt_attr *attr,
				       uint16_t value)
{
	ARG_UNUSED(attr);

	bool notif_enabled = (value == BT_GATT_CCC_NOTIFY);

	LOG_INF("BAS Notifications %s", notif_enabled ? "enabled" : "disabled");
}

static ssize_t on_receive(struct bt_conn *conn,
			  const struct bt_gatt_attr *attr,
			  const void *buf,
			  uint16_t len,
			  uint16_t offset,
			  uint8_t flags)
{
    const uint8_t * buffer = buf;

    
	printk("Received data, handle %d, conn %p, data: 0x", attr->handle, conn, len);
    for(uint8_t i = 0; i < len; i++){
        printk("%02X", buffer[i]);
		SoundValue = buffer[i];//printk("%d", buffer[i]);
    }
    printk("\n");

	return len;
}


static ssize_t read_blvl(struct bt_conn *conn,
			       const struct bt_gatt_attr *attr, void *buf,
			       uint16_t len, uint16_t offset)
{
	uint8_t lvl8 = SoundValue;

	return bt_gatt_attr_read(conn, attr, buf, len, offset, &lvl8,
				 sizeof(lvl8));
}

BT_GATT_SERVICE_DEFINE(Buzzer,
	BT_GATT_PRIMARY_SERVICE(BT_UUID_DECLARE_16(0x1401)),
	BT_GATT_CHARACTERISTIC(BT_UUID_DECLARE_16(0x1405),
			       BT_GATT_CHRC_WRITE | BT_GATT_CHRC_WRITE_WITHOUT_RESP,
			       BT_GATT_PERM_READ | BT_GATT_PERM_WRITE,
                   read_blvl, on_receive,
			       &SoundValue),
	BT_GATT_CCC(blvl_ccc_cfg_changed,
		    BT_GATT_PERM_READ | BT_GATT_PERM_WRITE),
);

static int buz_init(void)
{

	return 0;
}

char bt_buz_get_sound_value(void)
{
	return SoundValue;
}

int bt_buz_set_sound_value(uint8_t level)
{
	int rc;


	SoundValue = level;

	rc = bt_gatt_notify(NULL, &Buzzer.attrs[1], &level, sizeof(level));

	return rc == -ENOTCONN ? 0 : rc;
}


SYS_INIT(buz_init, APPLICATION, CONFIG_APPLICATION_INIT_PRIORITY);
```

## src/buzzer.h
```c
/*
 * Copyright (c) 2018 Nordic Semiconductor ASA
 * Copyright (c) 2016 Intel Corporation
 *
 * SPDX-License-Identifier: Apache-2.0
 */

#ifndef MATH_INCLUDE_BLUETOOTH_SERVICES_BUZ_H_
#define MATH_INCLUDE_BLUETOOTH_SERVICES_BUZ_H_

/**
 * @brief Button Service 
 * @defgroup bt 
 * @ingroup bluetooth
 * @{
 *
 * [Experimental] Users should note that the APIs can change
 * as a part of ongoing development.
 */

#include <stdint.h>

#ifdef __cplusplus
extern "C" {
#endif

/** @brief Read the button value.
 *
 * Read the characteristic value of the button
 *
 *  @return The button is a boolean.
 */
char bt_buz_get_sound_value(void);


/** @brief Update button value.
 *
 * Update the characteristic value of the button
 * This will send a GATT notification to all current subscribers.
 *
 *  @param value The button value.
 *
 *  @return Zero in case of success and error code in case of error.
 */
int bt_buz_set_sound_value(uint8_t level);

#ifdef __cplusplus
}
#endif

/**
 * @}
 */

#endif /* MATH_INCLUDE_BLUETOOTH_SERVICES_BUZ_H_ */
```

## src/peripherique.c
```c
/** @file peripherique.c
 *  @brief service de gestion des peripheriques
 */

#include <errno.h>
#include <zephyr/init.h>
#include <zephyr/sys/__assert.h>
#include <stdbool.h>
#include <zephyr/types.h>

#include <zephyr/bluetooth/bluetooth.h>
#include <zephyr/bluetooth/conn.h>
#include <zephyr/bluetooth/gatt.h>
#include <zephyr/bluetooth/uuid.h>
#include <zephyr/bluetooth/services/bas.h>
#define LOG_LEVEL CONFIG_BT_BAS_LOG_LEVEL
#include <zephyr/logging/log.h>

LOG_MODULE_REGISTER(Peripherique);

static uint8_t buttonValue = 0;
static uint8_t SoundValue = 0;

static void blvl_ccc_cfg_button_changed(const struct bt_gatt_attr *attr,
				       uint16_t value)
{
	ARG_UNUSED(attr);

	bool notif_enabled = (value == BT_GATT_CCC_NOTIFY);

	LOG_INF("BAS Notifications %s", notif_enabled ? "enabled" : "disabled");
}

static ssize_t on_buz_receive(struct bt_conn *conn,
			  const struct bt_gatt_attr *attr,
			  const void *buf,
			  uint16_t len,
			  uint16_t offset,
			  uint8_t flags)
{
    const uint8_t * buffer = buf;

    
	printk("Received data, handle %d, conn %p, data: 0x", attr->handle, conn);
    for(uint8_t i = 0; i < len; i++){
        printk("%02X", buffer[i]);
		SoundValue = buffer[i];//printk("%d", buffer[i]);
    }
    printk("\n");

	return len;
}


static ssize_t read_buttonlvl(struct bt_conn *conn,
			       const struct bt_gatt_attr *attr, void *buf,
			       uint16_t len, uint16_t offset)
{
	uint8_t lvl8 = buttonValue;

	return bt_gatt_attr_read(conn, attr, buf, len, offset, &lvl8,
				 sizeof(lvl8));
}

static ssize_t read_buzlvl(struct bt_conn *conn,
			       const struct bt_gatt_attr *attr, void *buf,
			       uint16_t len, uint16_t offset)
{
	uint8_t lvl8 = SoundValue;

	return bt_gatt_attr_read(conn, attr, buf, len, offset, &lvl8,
				 sizeof(lvl8));
}

BT_GATT_SERVICE_DEFINE(Peripherique,
	BT_GATT_PRIMARY_SERVICE(BT_UUID_DECLARE_16(0x1401)),
    BT_GATT_CHARACTERISTIC(BT_UUID_DECLARE_16(0x1404),
			       BT_GATT_CHRC_NOTIFY,
			       BT_GATT_PERM_READ, read_buttonlvl, NULL,
			       &buttonValue),
    BT_GATT_CCC(blvl_ccc_cfg_button_changed,
		    BT_GATT_PERM_READ | BT_GATT_PERM_WRITE),
	BT_GATT_CHARACTERISTIC(BT_UUID_DECLARE_16(0x1405),
			       BT_GATT_CHRC_WRITE | BT_GATT_CHRC_WRITE_WITHOUT_RESP,
			       BT_GATT_PERM_READ | BT_GATT_PERM_WRITE,
                   read_buzlvl, on_buz_receive,
			       &SoundValue),
);


static int but_init(void)
{

	return 0;
}

char bt_but_get_button_value(void)
{
	return buttonValue;
}

int bt_but_set_button_value(uint8_t level)
{
	int rc;

	printk("%d\n", level);
	buttonValue = level;

	rc = bt_gatt_notify(NULL, &Peripherique.attrs[1], &level, sizeof(level));

	return rc == -ENOTCONN ? 0 : rc;
}


static int buz_init(void)
{

	return 0;
}

char bt_buz_get_sound_value(void)
{
	return SoundValue;
}

int bt_buz_set_sound_value(uint8_t level)
{
	int rc;


	SoundValue = level;

	rc = bt_gatt_notify(NULL, &Peripherique.attrs[1], &level, sizeof(level));

	return rc == -ENOTCONN ? 0 : rc;
}


SYS_INIT(but_init, APPLICATION, CONFIG_APPLICATION_INIT_PRIORITY);

SYS_INIT(buz_init, APPLICATION, CONFIG_APPLICATION_INIT_PRIORITY);
```

## src/peripherique.h
```c
/*
 * Copyright (c) 2018 Nordic Semiconductor ASA
 * Copyright (c) 2016 Intel Corporation
 *
 * SPDX-License-Identifier: Apache-2.0
 */

#ifndef MATH_INCLUDE_BLUETOOTH_SERVICES_PERIPH_H_
#define MATH_INCLUDE_BLUETOOTH_SERVICES_PERIPH_H_

/**
 * @brief Button Service 
 * @defgroup bt 
 * @ingroup bluetooth
 * @{
 *
 * [Experimental] Users should note that the APIs can change
 * as a part of ongoing development.
 */

#include <stdint.h>

#ifdef __cplusplus
extern "C" {
#endif

/** @brief Read the button value.
 *
 * Read the characteristic value of the button
 *
 *  @return The button is a boolean.
 */
char bt_buz_get_sound_value(void);


/** @brief Update button value.
 *
 * Update the characteristic value of the button
 * This will send a GATT notification to all current subscribers.
 *
 *  @param value The button value.
 *
 *  @return Zero in case of success and error code in case of error.
 */
int bt_buz_set_sound_value(uint8_t level);



/** @brief Read the button value.
 *
 * Read the characteristic value of the button
 *
 *  @return The button is a boolean.
 */
char bt_but_get_button_value(void);


/** @brief Update button value.
 *
 * Update the characteristic value of the button
 * This will send a GATT notification to all current subscribers.
 *
 *  @param value The button value.
 *
 *  @return Zero in case of success and error code in case of error.
 */
int bt_but_set_button_value(uint8_t level);

#ifdef __cplusplus
}
#endif

/**
 * @}
 */

#endif /* MATH_INCLUDE_BLUETOOTH_SERVICES_BUZ_H_ */
```
